/**
 * @cliArgs --device "F2837xD" --package "F2837xD_100PTP" --part "F2837xD_100PTP" --context "CPU1" --product "C2000WARE@4.03.00.00"
 * @versions {"tool":"1.16.1+2960"}
 */

/**
 * Import the modules used in this configuration.
 */
const usb  = scripting.addModule("/driverlib/usb.js", {}, false);
const usb1 = usb.addInstance();

/**
 * Write custom configuration values to the imported modules.
 */
usb1.$name                  = "myUSB0";
usb1.registerInterrupts     = true;
usb1.usbLib.usb_mode        = "Host";
usb1.usbLib.hostApplication = "Mass Storage";
usb1.USBInt.enableInterrupt = true;

/**
 * Pinmux solution for unlocked pins/peripherals. This ensures that minor changes to the automatic solver in a future
 * version of the tool will not impact the pinmux you originally saw.  These lines can be completely deleted in order to
 * re-solve from scratch.
 */
usb1.usb.$suggestSolution          = "USB0";
usb1.usb.usbdmPin.$suggestSolution = "GPIO42";
usb1.usb.usbdpPin.$suggestSolution = "GPIO43";
